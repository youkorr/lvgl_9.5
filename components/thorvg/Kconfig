## components/thorvg/Kconfig
```kconfig
menu "ThorVG Support Options"

    config THORVG_LOG_ENABLED
        bool "Enable ThorVG log"
        default n
        help
            Enable ThorVG log.

    config THORVG_THREAD_ENABLED
        bool "Enable ThorVG threading support"
        default n
        help
            Enable ThorVG threading support. When enabled, ThorVG dispatches
            rendering/parsing work to std::thread workers. On ESP-IDF those
            workers use the default pthread stack (CONFIG_PTHREAD_TASK_STACK_SIZE_DEFAULT,
            typically 3072 bytes) which is far too small for ThorVG's
            recursive vector pipeline and causes a "Stack protection fault"
            crash (e.g. when rendering Lottie frames).

            Leave this disabled unless you have explicitly bumped
            CONFIG_PTHREAD_TASK_STACK_SIZE_DEFAULT to at least 32768 bytes.
            With this disabled ThorVG runs synchronously on the calling
            FreeRTOS task, so make sure that task has a large stack
            (the bundled lottie_loader.h already uses a 64 KB PSRAM stack).

    config THORVG_LOTTIE_EXPRESSIONS_SUPPORT
        bool "Enable Lottie expressions (JerryScript)"
        default n
        depends on THORVG_LOTTIE_LOADER_SUPPORT
        help
            Enable JavaScript expression support in Lottie animations via JerryScript engine.
            WARNING: adds ~1.5MB to the binary. Only enable if your Lottie files use expressions.

    menu "Loaders Support"

        config THORVG_LOTTIE_LOADER_SUPPORT
            bool "Enable Lottie loader support"
            default y

        config THORVG_SVG_LOADER_SUPPORT
            bool "Enable svg loader support"
            default n

        config THORVG_PNG_LOADER_SUPPORT
            bool "Enable png loader support"
            default n

        config THORVG_JPEG_LOADER_SUPPORT
            bool "Enable jpeg loader support"
            default n

        config THORVG_WEBP_LOADER_SUPPORT
            bool "Enable webp loader support"
            default n

    endmenu

endmenu
```
